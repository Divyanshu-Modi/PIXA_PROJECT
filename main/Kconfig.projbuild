## main/Kconfig.projbuild
```kconfig
menu "PIXA"

	config PIXA_SSID
		string "WIFI ssid for the device to connect"
		default ""
		help
			WIFI ssid for the device to connect.

	config PIXA_PASS
		string "WIFI password for the device to connect"
		default ""
		help
			WIFI password for the device to connect.

	config PIXA_MQTT_SERVER
		string "PIXA MQTT server url"
		default ""
		help
			MQTT server for the processing action to be performed.

	config PIXA_MQTT_USERNAME
		string "PIXA MQTT server username"
		default ""
		help
			MQTT server username for the processing action to be performed.

	config PIXA_MQTT_PASSWORD
		string "PIXA MQTT server password"
		default ""
		help
			MQTT server password for the processing action to be performed.

endmenu
```
